// SPDX-License-Identifier: BSD-3-Clause
/*
 * Copyright (c) Qualcomm Technologies, Inc. and/or its subsidiaries.
 */

/ {
	qcom_hwinfo: qcom-hwinfo {
		compatible = "qcom,hwinfo";

		imem = <&sram>;
		imem-boot-cookie-offset = <0x0>;

		tcsr = <&tcsr>;
		tcsr-hw-version-offset = <0x8000>;
	};
};

&vreg_l8a {
	regulator-always-on;
};
