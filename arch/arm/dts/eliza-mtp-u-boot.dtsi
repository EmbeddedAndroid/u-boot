// SPDX-License-Identifier: BSD-3-Clause
/*
 * Copyright (c) Qualcomm Technologies, Inc. and/or its subsidiaries.
 */

#include <dt-bindings/input/linux-event-codes.h>

#include "eliza-u-boot.dtsi"

/*
 * Volume down (PMK8550 PON RESIN), for holding it to enter fastboot.
 * Carried here until the Linux DT enables it and that reaches
 * dts/upstream.
 */
&pon_resin {
	linux,code = <KEY_VOLUMEDOWN>;
	status = "okay";
};
