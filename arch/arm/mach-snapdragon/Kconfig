## arch/arm/mach-snapdragon/Kconfig
```kconfig
if ARCH_SNAPDRAGON

config SYS_SOC
	default "snapdragon"

config SYS_VENDOR
	string "Snapdragon board vendor"
	default "qualcomm"
	help
	  Allows to specify vendor for the Snapdragon SoCs based boards.
	  Based on this option board/<CONFIG_SYS_VENDOR>/<CONFIG_SYS_BOARD>
	  will be used as the custom board directory.

config SYS_MALLOC_F_LEN
	default 0x2000

config SPL_SYS_MALLOC_F
	default y

config SPL_SYS_MALLOC_F_LEN
	default 0x2000

config SYS_MALLOC_LEN
	default 0x800000

config LNX_KRNL_IMG_TEXT_OFFSET_BASE
	default 0x80000000

config SPL_SHARES_INIT_SP_ADDR
	# override the default from common/spl/Kconfig
	default n

config SPL_HAVE_INIT_STACK
	default y

config SYS_BOARD
	string "Snapdragon SoCs based board"
	help
	  Allows to specify the Snapdragon SoCs based board name.
	  Based on this option board/<CONFIG_SYS_VENDOR>/<CONFIG_SYS_BOARD>
	  will be used as the custom board directory.

config SYS_CONFIG_NAME
	string "Board configuration name"
	default SYS_BOARD if SYS_BOARD != ""
	default "qcom"
	help
	  This option contains information about board configuration name.
	  Based on this option include/configs/<CONFIG_SYS_CONFIG_NAME>.h header
	  will be used for board configuration.

config QCOM_GENERATE_MBN
	bool "Generate an MBN-compatible ELF binary"
	help
	  Enable this if you intend to flash U-Boot as a first-stage bootloader.
	  The build system will generate a board-specific ELF file with the appropriate
	  MBN hash segments and test keys.

	  New platforms can be added to tools/qcom/mkmbn/mkmbn.py if they aren't already
	  supported.

choice
	prompt "Qualcomm boot0.h workaround"
	optional
	help
	  While U-Boot on Qualcomm platforms doesn't generally need compile-time
	  adjustments based on the target SoC, workarounds in boot0.h can't
	  practically detect the SoC at runtime. Enable one of these workarounds
	  if you know you need it.

config BOOT0_MSM8916_PSCI_WORKAROUND
	bool "boot0.h workaround for buggy PSCI on the msm8916 SoC"
	help
	  Select this if you are building U-Boot proper for an msm8916 board that
	  uses the buggy PSCI implementation.

config BOOT0_SDM845_WORKAROUND
	bool "boot0.h workaround for SPL on the sdm845 SoC"
	depends on SPL
	help
	  Select this if you are building U-Boot SPL for sdm845.

config BOOT0_QCOM_BOOT_CPU
	bool "boot0.h hook to run U-Boot on a selected CPU"
	depends on ENABLE_ARM_SOC_BOOT0_HOOK
	help
	  If U-Boot is entered on a CPU other than QCOM_BOOT_CPU_MPIDR, start
	  that CPU at the U-Boot entry point with PSCI CPU_ON and turn the
	  entering CPU off. PSCI must be available through SMC.

	  On QCS8275, a kernel with pointer authentication enabled cannot
	  bring up the Cortex-A55 cores when booted on a Cortex-A78C.

endchoice

config QCOM_BOOT_CPU_MPIDR
	hex "MPIDR affinity of the CPU to run U-Boot on"
	depends on BOOT0_QCOM_BOOT_CPU
	default 0x0
	help
	  Aff3..Aff0 fields of the target CPU's MPIDR.

endif
```

## configs/qcom_monaco_spl_defconfig
```kconfig
CONFIG_ARM=y
CONFIG_SKIP_LOWLEVEL_INIT=y
CONFIG_SPL_SYS_DCACHE_OFF=y
CONFIG_COUNTER_FREQUENCY=19200000
CONFIG_POSITION_INDEPENDENT=y
CONFIG_SYS_INIT_SP_BSS_OFFSET=0x180000
CONFIG_ARCH_SNAPDRAGON=y
CONFIG_NR_DRAM_BANKS=24
CONFIG_DEFAULT_DEVICE_TREE="qcom/monaco-arduino-monza"
CONFIG_SPL_SYS_MALLOC_F_LEN=0x4000
# CONFIG_SPL_MMC is not set
CONFIG_SPL_SERIAL=y
CONFIG_SPL_STACK=0x1469a000
CONFIG_SPL_TEXT_BASE=0x14680000
CONFIG_SPL_BSS_START_ADDR=0x14690000
CONFIG_SPL_BSS_MAX_SIZE=0x2000
CONFIG_SYS_LOAD_ADDR=0xa0000000
CONFIG_SPL_SIZE_LIMIT=0x10000
CONFIG_SPL=y
CONFIG_DEBUG_UART_BASE=0x99c000
CONFIG_DEBUG_UART_CLOCK=14745600
CONFIG_DEBUG_UART=y
CONFIG_FIT=y
CONFIG_SPL_LOAD_FIT=y
CONFIG_SPL_LOAD_FIT_ADDRESS=0xaf000000
# CONFIG_DISPLAY_CPUINFO is not set
CONFIG_SPL_MAX_SIZE=0x10000
CONFIG_SPL_REMAKE_ELF=y
CONFIG_SPL_RAM_DEVICE=y
CONFIG_SPL_ATF=y
CONFIG_SPL_ATF_LOAD_IMAGE_V2=y
CONFIG_SPL_ATF_NO_PLATFORM_PARAM=y
CONFIG_MISC=y
CONFIG_QCOM_GENI=y
CONFIG_DEBUG_UART_MSM_GENI=y
CONFIG_DEBUG_UART_SKIP_INIT=y
CONFIG_MSM_GENI_SERIAL=y
```
